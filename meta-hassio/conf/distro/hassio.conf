## meta-hassio/conf/distro/hassio.conf
```bitbake
# Add hassio flavor
require conf/distro/include/resin-os.inc

PREFERRED_PROVIDER_docker-disk = "docker-resin-supervisor-disk"
RESIN_CONNECTABLE_SERVICES_remove = "openvpn"
```

## meta-hassio/conf/layer.conf
```bitbake
BBPATH .= ":${LAYERDIR}"

BBFILES += "${LAYERDIR}/recipes-*/*/*.bb \
            ${LAYERDIR}/recipes-*/*/*.bbappend"

BBFILE_COLLECTIONS += "hassio"
BBFILE_PATTERN_hassio = "^${LAYERDIR}/"

LAYERVERSION_hassio = "1"
LAYERDEPENDS_hassio = "resin-common"
```
